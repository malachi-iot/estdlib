## test/rtos/esp8266/template/Kconfig.projbuild
```kconfig
menu "Network configuration"

config WIFI_SSID
    string "WiFi SSID Name"

config WIFI_PASSWORD
    string "WiFi Password"

endmenu
```

## tools/esp-idf/Kconfig.projbuild
```kconfig
menu "estdlib"

# FIX: Not really tested or properly working, just a placeholder

config FEATURE_ESTD_IOS_GCOUNT
    bool "Enable or disable basic_istream::gcount()"
    default false

endmenu
```
